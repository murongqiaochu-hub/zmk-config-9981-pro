## config/boards/arm/bbp9981/Kconfig.board
```kconfig
# Copyright (c) 2025 ZitaoTech
# SPDX-License-Identifier: MIT

config BOARD_BBP9981
    bool "bbp9981"
    depends on SOC_NRF52840_QIAA

menu "A320 Trackpad Setting"

config A320_TRACKPAD_SCROLL_INTERVAL
    int "Legacy trackpad scroll interval (currently unused)"
    default 50
    range 0 200
    help
      Retained for compatibility. The A320 driver currently uses its existing
      40 ms sample-count window; this legacy value does not change scroll speed.

config A320_LOG_LEVEL
    int "Log Level for Touch"
    default 4

config A320
    bool "A320 Driver"
    depends on I2C && GPIO
    help
      A320 optical X/Y movement sensor used by the 9981 Pro trackpad.

config INPUT_A320_INIT_PRIORITY
    int "A320 Initialization Priority"
    default 90

config A320_CONTACT_PROBE
    bool "Read-only contact diagnostics (no tap-click output)"
    depends on I2C && ZMK_USB && UART_LINE_CTRL
    default n

config A320_CONTACT_PROBE_INTERVAL_MS
    int "Contact diagnostic polling interval in milliseconds"
    depends on A320_CONTACT_PROBE
    default 20
    range 20 500

config A320_BUS_COMPARE
    bool "Compare reg00 pointer/read transaction methods (read-only)"
    depends on A320_CONTACT_PROBE
    default n

config A320_BUS_COMPARE_INTERVAL_MS
    int "Transaction comparison interval"
    depends on A320_BUS_COMPARE
    default 500
    range 200 2000

config A320_TAP_OUTPUT
    bool "Compile mouse click bridge and transport snapshots"
    depends on ZMK_POINTING && I2C && GPIO && (ZMK_USB || ZMK_BLE)
    default n
    help
      Compile the real verified-contact/FSM/output bridge and SDK snapshots.
      This is NOT confirmation of a 9380 contact protocol. Unknown providers
      remain disabled and produce no synthetic clicks.

config A320_MICROTAP
    bool "Experimental opt-in motion gesture with left shoulder triple toggle"
    depends on A320_TAP_OUTPUT
    default n
    help
      Compile the micro-motion gesture buffer. Runtime is OFF after reboot.
      Default-layer left shoulder triple tap toggles it without a sensor probe.
      This is a motion heuristic, not verified finger contact recognition.

config BBP9981_MENU_DIAG
    bool "Bounded menu/left-button chain diagnostics"
    depends on BOARD_BBP9981 && A320_TAP_OUTPUT && LOG
    default n
    help
      Observe only three matrix keys, GUI/button snapshots and mouse TX outcomes.
      Does not change GPIO, HID descriptors, key behavior or transport preference.

config BBP9981_GAMEPAD
    bool "Xbox-layout standard HID gamepad on MEDIA layer"
    depends on BOARD_BBP9981 && (ZMK_USB || ZMK_BLE)
    default n
    help
      Add report ID4 and a gamepad behavior without using keyboard keycodes.
      USB uses its own HID_1 interface; BLE appends an encrypted input report.
      Requires matching bindings. Relative trackpad motion drives one stick
      at a time; LT/RT are digital. This is not native XInput and has no rumble.

config BBP9981_BLE_HID_METADATA_COMPAT
    bool "Standards-compliant BLE HID metadata candidate"
    depends on BBP9981_GAMEPAD && ZMK_BLE && BT_DIS && BT_DIS_PNP
    default n
    help
      Advertise implemented HID 1.11 in the HID Information read response while
      preserving its country and flags. This does not change any report map,
      report body, characteristic, CCC, route, security or pairing policy.
      The product config also corrects the USB-IF PnP namespace and adds the
      standard DIS software revision characteristic for native schema refresh.
      Software validation is not a claim of iPad device compatibility.

# IPDIAG_BEGIN_KCONFIG
config BBP9981_IPAD_DIAG
    bool "Bounded privacy-safe iPad HOG enumeration observer"
    depends on BBP9981_GAMEPAD && ZMK_BLE && ZMK_USB && BT_SMP
    depends on A320_TAP_OUTPUT && ZMK_HID_INDICATORS && ZMK_POINTING
    depends on LOG_MODE_DEFERRED && LOG_BACKEND_UART && UART_LINE_CTRL
    depends on !ZMK_POINTING_SMOOTH_SCROLLING && !LOG_BLOCK_IN_THREAD
    default n
    help
      Observes existing HOG reads, original notify results and current per-peer
      CCC/security/MTU. No report bytes, addresses, pairing keys or settings.
      Uses a fixed 64-entry RAM ring and DTR-gated bounded deferred log output.
      A notify success is not proof of host delivery or HID driver binding.
# IPDIAG_END_KCONFIG

endmenu
```

## config/dts/bindings/behaviors/zmk,behavior-aa-scroll-gesture-key.yaml
```yaml
# SPDX-License-Identifier: MIT
description: UPPER BlackBerry/Back BT slots when aA-held or triple-tap fixed direction presets when locked; aA-held F double-tap toggles inverted mouse
compatible: "zmk,behavior-aa-scroll-gesture-key"
include: zero_param.yaml
```

## config/dts/bindings/behaviors/zmk,behavior-aa-scroll-shoulder.yaml
```yaml
# SPDX-License-Identifier: MIT
description: UPPER shoulders use native msc while unlocked or aA-held; while locked they halve trackpad scrolling and suppress their own wheel
compatible: "zmk,behavior-aa-scroll-shoulder"
include: one_param.yaml
```

## config/dts/bindings/behaviors/zmk,behavior-aa-sym-ctrl.yaml
```yaml
# SPDX-License-Identifier: MIT
description: Ctrl while physical aA is held, otherwise return to the default layer
compatible: "zmk,behavior-aa-sym-ctrl"
include: zero_param.yaml
```

## config/dts/bindings/behaviors/zmk,behavior-cursor-speed.yaml
```yaml
# SPDX-License-Identifier: MIT
description: Cycle persistent ordinary mouse gain presets
compatible: "zmk,behavior-cursor-speed"
include: zero_param.yaml
```

## config/dts/bindings/behaviors/zmk,behavior-gamepad.yaml
```yaml
# SPDX-License-Identifier: MIT
description: Xbox-layout standard HID action in MEDIA (UP0 DOWN1 LEFT2 RIGHT3 A4 B5 X6 Y7 LB8 RB9 LT10 RT11 VIEW12 MENU13 GUIDE14 L3-15 R3-16 RIGHTMOD17 CLICK18); not XInput
compatible: "zmk,behavior-gamepad"
include: one_param.yaml
```

## config/dts/bindings/behaviors/zmk,behavior-microtap-shoulder.yaml
```yaml
description: Default left shoulder mouse click with triple-tap micro-motion toggle
compatible: "zmk,behavior-microtap-shoulder"
include: zero_param.yaml
```
